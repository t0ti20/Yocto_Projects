## Raspberrypi-4_Minimal/conf/bblayers.conf
```bitbake
# POKY_BBLAYERS_CONF_VERSION is increased each time build/conf/bblayers.conf
# changes incompatibly
POKY_BBLAYERS_CONF_VERSION = "2"

BBPATH = "${TOPDIR}"
BBFILES ?= ""

BBLAYERS ?= " \
  /home/t0ti20/Desktop/poky/meta \
  /home/t0ti20/Desktop/poky/meta-poky \
  /home/t0ti20/Desktop/poky/meta-yocto-bsp \
  /home/t0ti20/Desktop/poky/meta-openembedded/meta-oe \
  /home/t0ti20/Desktop/poky/meta-raspberrypi \
  /home/t0ti20/Desktop/poky/meta-openembedded/meta-python \
  /home/t0ti20/Desktop/poky/meta-openembedded/meta-multimedia \
  /home/t0ti20/Desktop/poky/meta-openembedded/meta-networking \
  /home/t0ti20/Desktop/poky/meta-application \
  /home/t0ti20/Desktop/poky/meta-skeleton \
  /home/t0ti20/Desktop/poky/build/workspace \
  "
```

## meta-rpi4/conf/layer.conf
```bitbake
# We have a conf and classes directory, add to BBPATH
BBPATH .= ":${LAYERDIR}"

# We have recipes-* directories, add to BBFILES
BBFILES += "${LAYERDIR}/recipes-*/*/*.bb \
            ${LAYERDIR}/recipes-*/*/*.bbappend"

BBFILE_COLLECTIONS += "meta-rpi4"
BBFILE_PATTERN_meta-rpi4 = "^${LAYERDIR}/"
BBFILE_PRIORITY_meta-rpi4 = "6"

LAYERDEPENDS_meta-rpi4 = "core"
LAYERSERIES_COMPAT_meta-rpi4 = "kirkstone"
```
